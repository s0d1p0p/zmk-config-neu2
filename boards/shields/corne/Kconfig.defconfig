## boards/shields/corne/Kconfig.defconfig
```kconfig
if SHIELD_SPL1T_DONGLE

config ZMK_KEYBOARD_NAME
    default "Spl1t"

config ZMK_SPLIT_ROLE_CENTRAL
    default y

config ZMK_USB
    default y

config ZMK_SPLIT_BLE_CENTRAL_PERIPHERALS
    default 2

# Set this to ZMK_SPLIT_BLE_CENTRAL_PERIPHERALS + your desired number of BT profiles (default is 5)
config BT_MAX_CONN
    default 5

# Set this to the same number as BT_MAX_CONN
config BT_MAX_PAIRED
    default 5

endif

if SHIELD_SPL1T_LEFT || SHIELD_SPL1T_RIGHT || SHIELD_SPL1T_DONGLE

config ZMK_SPLIT
    default y

if ZMK_DISPLAY

config I2C
    default y

config SSD1306
    default y

endif # ZMK_DISPLAY

if LVGL

config LV_Z_VDB_SIZE
    default 64

config LV_DPI_DEF
    default 148

config LV_Z_BITS_PER_PIXEL
    default 1

choice LV_COLOR_DEPTH
    default LV_COLOR_DEPTH_1
endchoice

endif # LVGL

endif
```
